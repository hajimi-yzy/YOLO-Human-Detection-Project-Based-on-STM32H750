## communication/固件/esp32s3_l610_ps2_v5/components/camera_stream/Kconfig
```kconfig
menu "L610 UDP Camera Uplink"

    config VIDEO_UDP_SERVER_IP
        string "Video UDP server IPv4 address"
        default "192.0.2.10"

    config VIDEO_UDP_SERVER_PORT
        int "Video UDP server port"
        range 1 65535
        default 9091

    config VIDEO_LOCAL_MJPEG_PORT
        int "SoftAP local MJPEG HTTP port"
        range 1 65535
        default 8080
        help
            Local-only MJPEG viewer and stream port. With the default SoftAP
            gateway, open http://192.168.4.1:8080/ or use the raw stream at
            http://192.168.4.1:8080/live/mjpeg.

    config VIDEO_UDP_PROTOCOL_VERSION
        int "ESJP protocol version"
        range 1 3
        default 1
        help
            Version written to the ESJP packet header. Version 1 uses the
            production 1200-byte application payload. Experimental versions
            must select their matching sdkconfig defaults overlay.

    config VIDEO_UDP_PAYLOAD_SIZE
        int "ESJP chunk payload size"
        range 256 65469
        default 1200
        help
            JPEG bytes carried by one ESJP UDP datagram. Values above the
            network MTU intentionally exercise lwIP IPv4 fragmentation and
            require a matching server-side ESJP configuration.

    config VIDEO_UDP_FPS
        int "Target JPEG upload frame rate"
        range 1 60
        default 8

    config VIDEO_UDP_BURST_PACKETS
        int "UDP packets sent before yielding to RNDIS"
        range 1 16
        default 3
        help
            Limits each back-to-back UDP burst. The L610 RNDIS path has been
            observed to accept roughly three packets before its transmit path
            needs service time.

    config VIDEO_UDP_BURST_YIELD_MS
        int "RNDIS service time between UDP bursts (ms)"
        range 0 10
        default 1
        help
            Yield after each packet burst so the USB Host and RNDIS tasks can
            drain their transmit queues. At a 1000 Hz FreeRTOS tick, 1 ms is
            the smallest scheduler-backed delay.

    config VIDEO_UDP_FLOW_COUNT
        int "Parallel UDP flows"
        range 1 8
        default 1
        help
            Send complete JPEG frames round-robin over multiple connected UDP
            sockets. Each frame stays on one source port, while the aggregate
            video rate is distributed across independent five-tuples.

    config VIDEO_UDP_WARMUP_STEP_SECONDS
        int "Duration of each startup upload-rate step (seconds)"
        range 0 60
        default 10
        help
            After RNDIS gets an IP address, ramp video through 5, 10 and 20
            FPS before using the configured maximum. This gives the L610 LTE
            bearer and RNDIS transmit path time to stabilize. Set to 0 to
            disable the startup ramp.

    config VIDEO_UDP_EXTENDED_RAMP
        bool "Use extended RNDIS startup upload-rate ramp"
        default n
        help
            Replace the standard equal-duration 5, 10 and 20 FPS ramp with
            5 FPS for 15 seconds, 8 FPS for 20 seconds, then 10, 12, 15 and
            20 FPS for 30 seconds each before using the configured target.
            Intended for isolated LTE/RNDIS packet-loss experiments.

    choice VIDEO_CAMERA_FRAME_SIZE
        prompt "OV5640 JPEG frame size"
        default VIDEO_CAMERA_FRAME_SIZE_VGA

        config VIDEO_CAMERA_FRAME_SIZE_VGA
            bool "VGA (640x480)"

        config VIDEO_CAMERA_FRAME_SIZE_QVGA
            bool "QVGA (320x240)"
    endchoice

    config VIDEO_CAMERA_JPEG_QUALITY
        int "OV5640 JPEG quality"
        range 0 63
        default 12
        help
            OV-series JPEG quality scale. Lower values preserve more detail
            and produce larger JPEG frames; higher values compress more.


endmenu
```

## communication/固件/esp32s3_l610_ps2_v5/components/telemetry_uart/Kconfig
```kconfig
menu "Unified USART Telemetry"

    config TELEMETRY_UART_ENABLE
        bool "Enable framed sensor + GPS USART uplink"
        default y

    config TELEMETRY_UART_SHARED_CONSOLE_TEST
        depends on TELEMETRY_UART_ENABLE
        bool "TEMPORARY: receive telemetry on the console UART"
        default n
        help
            Test-only mode for a single CH340/TTL port. Uses the configured
            ESP console UART without remapping pins, so the same port can
            print logs and receive ESUT frames. Never enable this in the
            deployed controller wiring profile.

    config TELEMETRY_UART_NUM
        depends on TELEMETRY_UART_ENABLE
        int "UART controller number"
        range 1 2
        default 1

    config TELEMETRY_UART_TX_GPIO
        depends on TELEMETRY_UART_ENABLE
        int "UART TX GPIO (ESP32 -> controller)"
        range 0 48
        default 1

    config TELEMETRY_UART_RX_GPIO
        depends on TELEMETRY_UART_ENABLE
        int "UART RX GPIO (controller -> ESP32)"
        range 0 48
        default 2

    config TELEMETRY_UART_BAUD
        depends on TELEMETRY_UART_ENABLE
        int "UART baud rate"
        range 9600 921600
        default 115200

    config TELEMETRY_UART_FRAME_TIMEOUT_MS
        depends on TELEMETRY_UART_ENABLE
        int "Maximum time from frame header to complete frame"
        range 20 5000
        default 300

    config TELEMETRY_HEARTBEAT_INTERVAL_MS
        depends on TELEMETRY_UART_ENABLE
        int "ESP online heartbeat interval (ms)"
        range 500 30000
        default 2000
        help
            The ESP sends an ESUT/1 heartbeat through L610 even when STM32
            has not supplied a sensor frame. Server-side ESP online status
            is based on these heartbeats, not on STM32 data availability.

    config TELEMETRY_DEVICE_ID
        depends on TELEMETRY_UART_ENABLE
        string "Telemetry device ID"
        default "esp32s3-01"

    config TELEMETRY_UDP_SERVER_IP
        depends on TELEMETRY_UART_ENABLE
        string "Telemetry UDP server IPv4 address"
        default "192.0.2.10"

    config TELEMETRY_UDP_SERVER_PORT
        depends on TELEMETRY_UART_ENABLE
        int "Telemetry UDP server port"
        range 1 65535
        default 9093

endmenu
```

## communication/固件/esp32s3_l610_ps2_v5/main/Kconfig.projbuild
```kconfig
menu "Example Configuration"

    config EXAMPLE_USB_RNDIS_DOWNLOAD_SPEED_TEST
        bool "Enable USB RNDIS Download Speed Test"
        default n
        help
            Enable USB RNDIS Download Speed Test.

    config EXAMPLE_ENABLE_AT_CMD
        bool "Enable USB RNDIS AT Command"
        default y
        help
            Enable L610 automatic AT configuration before waiting for RNDIS DHCP.

    config EXAMPLE_AT_INTERFACE_NUM
        depends on EXAMPLE_ENABLE_AT_CMD
        int "USB RNDIS AT Interface Number"
        default 7
        help
            L610 USB mode 33 commonly exposes AT on interface 7 or 8.
            Interface 7 is preferred; firmware automatically falls back to interface 8.

    config L610_APN
        depends on EXAMPLE_ENABLE_AT_CMD
        string "L610 APN"
        default "CMNET"
        help
            Public APN used for PDP context 1.

    config L610_SOFTAP_SHARE_ENABLE
        bool "Share L610 internet through Wi-Fi SoftAP/NAPT"
        default n
        help
            Start the Wi-Fi access point only after L610 RNDIS has received
            an IPv4 address, then route SoftAP clients through that RNDIS
            interface. Camera profiles keep this disabled unless their
            profile defaults explicitly enable hotspot sharing.

    config VIDEO_CAMERA_ENABLE
        bool "Enable OV5640 camera capture and ESJP UDP video"
        default y
        help
            Initializes the OV5640, generates XCLK and starts the continuous
            JPEG/UDP video task. Turn this off only for isolated UART/L610
            diagnostics; the regular video firmware keeps it enabled.
endmenu
```
